## app/dts/bindings/behaviors/zero_param.yaml
```yaml
# Copyright (c) 2020 The ZMK Contributors
# SPDX-License-Identifier: MIT

properties:
  label:
    type: string
    required: false
  "#binding-cells":
    type: int
    required: true
    const: 0
```
